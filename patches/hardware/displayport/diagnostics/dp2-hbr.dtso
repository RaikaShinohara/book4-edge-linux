// SPDX-License-Identifier: BSD-3-Clause
/dts-v1/;
/plugin/;

&{/soc@0/display-subsystem@ae00000/displayport-controller@ae98000/ports/port@1/endpoint} {
	link-frequencies = /bits/ 64 <1620000000 2700000000>;
};
